## build/conf/bblayers.conf
```bitbake
# POKY_BBLAYERS_CONF_VERSION is increased each time build/conf/bblayers.conf
# changes incompatibly
POKY_BBLAYERS_CONF_VERSION = "2"

BBPATH = "${TOPDIR}"
BBFILES ?= ""

BBLAYERS ?= " \
  ${TOPDIR}/../oe/poky/meta \
  ${TOPDIR}/../oe/poky/meta-poky \
  ${TOPDIR}/../oe/poky/meta-yocto-bsp \
  ${TOPDIR}/../oe/meta-tegra \
  "
```
